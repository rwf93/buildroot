## configs/hellrisc32_defconfig
```kconfig
BR2_riscv=y
BR2_RISCV_32=y
BR2_PACKAGE_HOST_LINUX_HEADERS_CUSTOM_6_1=y
BR2_TOOLCHAIN_BUILDROOT_CXX=y
BR2_TARGET_GENERIC_HOSTNAME="hellbox"
BR2_TARGET_GENERIC_ISSUE="Welcome to HELL"
BR2_SYSTEM_DHCP="eth0"
BR2_ROOTFS_OVERLAY="board/hellrisc/hellrisc32/rootfs-overlay"
BR2_ROOTFS_POST_IMAGE_SCRIPT="board/hellrisc/post-image.sh"
BR2_ROOTFS_POST_SCRIPT_ARGS="$(BR2_DEFCONFIG)"
BR2_LINUX_KERNEL=y
BR2_LINUX_KERNEL_CUSTOM_VERSION=y
BR2_LINUX_KERNEL_CUSTOM_VERSION_VALUE="6.1.44"
BR2_LINUX_KERNEL_USE_CUSTOM_CONFIG=y
BR2_LINUX_KERNEL_CUSTOM_CONFIG_FILE="board/hellrisc/hellrisc32/linux.config"
BR2_LINUX_KERNEL_ZSTD=y
BR2_PACKAGE_BUSYBOX_CONFIG="board/hellrisc/busybox.config"
BR2_PACKAGE_LUA=y
BR2_TARGET_ROOTFS_CPIO=y
BR2_TARGET_ROOTFS_CPIO_ZSTD=y
BR2_TARGET_ROOTFS_TAR_ZSTD=y
BR2_TARGET_OPENSBI=y
BR2_TARGET_OPENSBI_CUSTOM_VERSION=y
BR2_TARGET_OPENSBI_CUSTOM_VERSION_VALUE="1.2"
BR2_TARGET_OPENSBI_PLAT="generic"
BR2_PACKAGE_HOST_E2FSPROGS=y
BR2_PACKAGE_HOST_QEMU=y
BR2_PACKAGE_HOST_QEMU_SYSTEM_MODE=y
```

## configs/xbox360_defconfig
```kconfig
BR2_powerpc64=y
BR2_powerpc_970=y
BR2_KERNEL_HEADERS_5_15=y
BR2_TOOLCHAIN_BUILDROOT_CXX=y
BR2_PACKAGE_OVERRIDE_FILE=""
BR2_TARGET_GENERIC_GETTY_PORT="ttyS0"
BR2_SYSTEM_DHCP="eth0"
BR2_ROOTFS_OVERLAY="board/xbox360/rootfs-overlay"
BR2_ROOTFS_POST_IMAGE_SCRIPT="board/qemu/post-image.sh"
BR2_ROOTFS_POST_SCRIPT_ARGS="$(BR2_DEFCONFIG)"
BR2_LINUX_KERNEL=y
BR2_LINUX_KERNEL_CUSTOM_GIT=y
BR2_LINUX_KERNEL_CUSTOM_REPO_URL="https://github.com/rwf93/linux"
BR2_LINUX_KERNEL_CUSTOM_REPO_VERSION="xenon-5.17"
BR2_LINUX_KERNEL_DEFCONFIG="xenon"
BR2_LINUX_KERNEL_IMAGE_TARGET_CUSTOM=y
BR2_LINUX_KERNEL_IMAGE_NAME="zImage.xenon"
BR2_PACKAGE_BUSYBOX_SHOW_OTHERS=y
BR2_PACKAGE_GIT=y
BR2_PACKAGE_PCIUTILS=y
BR2_PACKAGE_LUA=y
BR2_PACKAGE_CA_CERTIFICATES=y
BR2_PACKAGE_OPENSSL=y
BR2_PACKAGE_JSON_C=y
BR2_PACKAGE_LIBCURL=y
BR2_PACKAGE_LIBCURL_CURL=y
BR2_PACKAGE_LIBWEBSOCKETS=y
BR2_PACKAGE_LIBUV=y
BR2_PACKAGE_READLINE=y
BR2_PACKAGE_DHCPCD=y
BR2_PACKAGE_DROPBEAR=y
# BR2_PACKAGE_DROPBEAR_CLIENT is not set
BR2_PACKAGE_NTP=y
BR2_PACKAGE_NTP_NTPDATE=y
BR2_PACKAGE_NTP_NTPTIME=y
BR2_PACKAGE_SOCAT=y
BR2_PACKAGE_WGET=y
BR2_PACKAGE_HTOP=y
BR2_PACKAGE_UTIL_LINUX=y
BR2_PACKAGE_UTIL_LINUX_BINARIES=y
BR2_PACKAGE_UTIL_LINUX_HWCLOCK=y
BR2_PACKAGE_UTIL_LINUX_MOUNT=y
BR2_PACKAGE_UTIL_LINUX_PARTX=y
BR2_TARGET_ROOTFS_CPIO=y
BR2_TARGET_ROOTFS_CPIO_ZSTD=y
# BR2_TARGET_ROOTFS_TAR is not set
BR2_PACKAGE_HOST_E2FSPROGS=y
```
